/**
 * These arguments were used when this file was generated. They will be automatically applied on subsequent loads
 * via the GUI or CLI. Run CLI with '--help' for additional information on how to override these arguments.
 * @cliArgs --device "XWRL64XX" --part "Default" --package "FCCSP" --context "m4fss0-0" --product "MMWAVE-L-SDK@05.05.03"
 * @v2CliArgs --device "IWRL6432" --package "FCCSP (AMF)" --context "m4fss0-0" --product "MMWAVE-L-SDK@05.05.03"
 * @versions {"tool":"1.21.1+3772"}
 */

/**
 * Import the modules used in this configuration.
 */
const flash      = scripting.addModule("/board/flash/flash", {}, false);
const flash1     = flash.addInstance();
const edma       = scripting.addModule("/drivers/edma/edma", {}, false);
const edma1      = edma.addInstance();
const hwa        = scripting.addModule("/drivers/hwa/hwa", {}, false);
const hwa1       = hwa.addInstance();
const uart       = scripting.addModule("/drivers/uart/uart", {}, false);
const uart1      = uart.addInstance();
const clock      = scripting.addModule("/kernel/dpl/clock");
const debug_log  = scripting.addModule("/kernel/dpl/debug_log");
const mpu_armv7  = scripting.addModule("/kernel/dpl/mpu_armv7", {}, false);
const mpu_armv71 = mpu_armv7.addInstance();
const mpu_armv72 = mpu_armv7.addInstance();
const mpu_armv73 = mpu_armv7.addInstance();
const mpu_armv74 = mpu_armv7.addInstance();

/**
 * Write custom configuration values to the imported modules.
 */
flash1.$name                  = "CONFIG_FLASH0";
flash1.peripheralDriver.$name = "CONFIG_QSPI0";

hwa1.$name = "CONFIG_HWA0";

uart1.intrEnable      = "DISABLE";
uart1.$name           = "CONFIG_UART_CONSOLE";
uart1.UART.$assign    = "UARTB";
uart1.UART.RX.$assign = "PAD_AP";
uart1.UART.TX.$assign = "PAD_AO";

edma1.$name                        = "CONFIG_EDMA0";
edma1.instance                     = "EDMA_APPSS_B";
flash1.peripheralDriver.edmaConfig = edma1;
uart1.edmaConfig                   = edma1;
edma1.edmaRmDmaCh[0].$name         = "CONFIG_EDMA_RM0";
edma1.edmaRmQdmaCh[0].$name        = "CONFIG_EDMA_RM1";
edma1.edmaRmTcc[0].$name           = "CONFIG_EDMA_RM2";
edma1.edmaRmParam[0].$name         = "CONFIG_EDMA_RM3";
edma1.edmaRmReservedDmaCh[0].$name = "CONFIG_EDMA_RM4";

mpu_armv71.$name        = "CONFIG_MPU_REGION0";
mpu_armv71.attributes   = "Device";
mpu_armv71.allowExecute = false;

mpu_armv72.$name    = "CONFIG_MPU_REGION1";
mpu_armv72.baseAddr = 0x400000;
mpu_armv72.size     = 19;

mpu_armv73.$name    = "CONFIG_MPU_REGION2";
mpu_armv73.baseAddr = 0x22400000;
mpu_armv73.size     = 19;

mpu_armv74.$name             = "CONFIG_MPU_REGION3";
mpu_armv74.size              = 18;
mpu_armv74.accessPermissions = "Supervisor RD, User RD";

/**
 * Pinmux solution for unlocked pins/peripherals. This ensures that minor changes to the automatic solver in a future
 * version of the tool will not impact the pinmux you originally saw.  These lines can be completely deleted in order to
 * re-solve from scratch.
 */
flash1.peripheralDriver.QSPI.$suggestSolution      = "QSPI0";
flash1.peripheralDriver.QSPI.DOUT.$suggestSolution = "PAD_AC";
flash1.peripheralDriver.QSPI.DIN.$suggestSolution  = "PAD_AD";
flash1.peripheralDriver.QSPI.DIN0.$suggestSolution = "PAD_AE";
flash1.peripheralDriver.QSPI.DIN1.$suggestSolution = "PAD_AF";
flash1.peripheralDriver.QSPI.CLK.$suggestSolution  = "PAD_AA";
flash1.peripheralDriver.QSPI.CS.$suggestSolution   = "PAD_AB";
