/**
 * @cliArgs --device "XWRL64XX" --package "FCCSP" --part "Default" --context "m4fss0-0" --product "MMWAVE-L-SDK@05.05.03"
 * @versions {"tool":"1.20.0+3587"}
 */

/**
 * Import the modules used in this configuration.
 */
const flash      = scripting.addModule("/board/flash/flash", {}, false);
const flash1     = flash.addInstance();
const edma       = scripting.addModule("/drivers/edma/edma", {}, false);
const edma1      = edma.addInstance();
const edma2      = edma.addInstance();
const gpio       = scripting.addModule("/drivers/gpio/gpio", {}, false);
const gpio1      = gpio.addInstance();
const hwa        = scripting.addModule("/drivers/hwa/hwa", {}, false);
const hwa1       = hwa.addInstance();
const mcspi      = scripting.addModule("/drivers/mcspi/mcspi", {}, false);
const mcspi1     = mcspi.addInstance();
const clock      = scripting.addModule("/kernel/dpl/clock");
const debug_log  = scripting.addModule("/kernel/dpl/debug_log");
const mpu_armv7  = scripting.addModule("/kernel/dpl/mpu_armv7", {}, false);
const mpu_armv71 = mpu_armv7.addInstance();
const mpu_armv72 = mpu_armv7.addInstance();
const mpu_armv73 = mpu_armv7.addInstance();
const mpu_armv74 = mpu_armv7.addInstance();

/**
 * Write custom configuration values to the imported modules.
 */
flash1.$name                  = "CONFIG_FLASH0";
flash1.peripheralDriver.$name = "CONFIG_QSPI0";

edma1.$name                        = "CONFIG_EDMA0";
edma1.instance                     = "EDMA_APPSS_B";
flash1.peripheralDriver.edmaConfig = edma1;
edma1.edmaRmDmaCh[0].$name         = "CONFIG_EDMA_RM0";
edma1.edmaRmQdmaCh[0].$name        = "CONFIG_EDMA_RM1";
edma1.edmaRmTcc[0].$name           = "CONFIG_EDMA_RM2";
edma1.edmaRmParam[0].$name         = "CONFIG_EDMA_RM3";
edma1.edmaRmReservedDmaCh[0].$name = "CONFIG_EDMA_RM4";

gpio1.$name                = "GPIO_LED";
gpio1.pinDir               = "OUTPUT";
gpio1.GPIO.$assign         = "GPIO";
gpio1.GPIO.gpioPin.$assign = "PAD_AV";

hwa1.$name = "CONFIG_HWA0";

mcspi1.$name                   = "CONFIG_MCSPI0";
mcspi1.intrEnable              = "DMA";
mcspi1.mode                    = "PERIPHERAL";
mcspi1.dpe1                    = "DISABLE";
mcspi1.dpe0                    = "ENABLE";
mcspi1.trMode                  = "TX_ONLY";
mcspi1.mcspiChannel[0].$name   = "CONFIG_MCSPI_CH0";
mcspi1.mcspiChannel[0].bitRate = 15000000;

edma2.$name                           = "CONFIG_EDMA1";
mcspi1.edmaDriver                     = edma2;
edma2.edmaRmDmaCh[0].$name            = "CONFIG_EDMA_RM5";
edma2.edmaRmQdmaCh[0].$name           = "CONFIG_EDMA_RM6";
edma2.edmaRmTcc[0].$name              = "CONFIG_EDMA_RM7";
edma2.edmaRmParam[0].$name            = "CONFIG_EDMA_RM8";
edma2.edmaRmReservedDmaCh[0].$name    = "CONFIG_EDMA_RM9";
edma2.edmaRmReservedDmaCh[0].endIndex = 1;

mpu_armv71.$name        = "CONFIG_MPU_REGION0";
mpu_armv71.attributes   = "Device";
mpu_armv71.allowExecute = false;

mpu_armv72.$name    = "CONFIG_MPU_REGION1";
mpu_armv72.baseAddr = 0x400000;
mpu_armv72.size     = 19;

mpu_armv73.$name    = "CONFIG_MPU_REGION2";
mpu_armv73.baseAddr = 0x22400000;
mpu_armv73.size     = 19;

mpu_armv74.$name             = "CONFIG_MPU_REGION3";
mpu_armv74.size              = 18;
mpu_armv74.accessPermissions = "Supervisor RD, User RD";

/**
 * Pinmux solution for unlocked pins/peripherals. This ensures that minor changes to the automatic solver in a future
 * version of the tool will not impact the pinmux you originally saw.  These lines can be completely deleted in order to
 * re-solve from scratch.
 */
flash1.peripheralDriver.QSPI.$suggestSolution      = "QSPI0";
flash1.peripheralDriver.QSPI.DOUT.$suggestSolution = "PAD_AC";
flash1.peripheralDriver.QSPI.DIN.$suggestSolution  = "PAD_AD";
flash1.peripheralDriver.QSPI.DIN0.$suggestSolution = "PAD_AE";
flash1.peripheralDriver.QSPI.DIN1.$suggestSolution = "PAD_AF";
flash1.peripheralDriver.QSPI.CLK.$suggestSolution  = "PAD_AA";
flash1.peripheralDriver.QSPI.CS.$suggestSolution   = "PAD_AB";
mcspi1.MCSPI.$suggestSolution                      = "MCSPIA";
mcspi1.MCSPI.CLK.$suggestSolution                  = "PAD_AG";
mcspi1.MCSPI.MOSI.$suggestSolution                 = "PAD_AI";
mcspi1.MCSPI.MISO.$suggestSolution                 = "PAD_AJ";
mcspi1.mcspiChannel[0].CSn.$suggestSolution        = "PAD_AH";
